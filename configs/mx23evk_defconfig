## configs/mx23evk_defconfig
```kconfig
CONFIG_ARM=y
CONFIG_ARCH_MX23=y
CONFIG_TEXT_BASE=0x40002000
CONFIG_SYS_MALLOC_F_LEN=0x400
CONFIG_SPL_GPIO=y
CONFIG_SPL_LIBCOMMON_SUPPORT=y
CONFIG_SPL_LIBGENERIC_SUPPORT=y
CONFIG_NR_DRAM_BANKS=1
CONFIG_ENV_SIZE=0x4000
CONFIG_ENV_OFFSET=0x40000
CONFIG_IMX_CONFIG=""
CONFIG_DM_GPIO=y
CONFIG_DEFAULT_DEVICE_TREE="imx23-evk"
CONFIG_TARGET_MX23EVK=y
CONFIG_SPL_SERIAL=y
CONFIG_SPL_TEXT_BASE=0x00001000
CONFIG_SYS_LOAD_ADDR=0x42000000
CONFIG_SPL=y
CONFIG_USE_BOOTCOMMAND=y
CONFIG_BOOTCOMMAND="mmc dev ${mmcdev}; if mmc rescan; then if run loadbootscript; then run bootscript; else if run loadimage; then run mmcboot; else echo ERR: Fail to boot from MMC; fi; fi; else exit; fi"
CONFIG_SYS_CONSOLE_IS_IN_ENV=y
# CONFIG_DISPLAY_BOARDINFO is not set
# CONFIG_SPL_FRAMEWORK is not set
CONFIG_SPL_NO_BSS_LIMIT=y
CONFIG_HUSH_PARSER=y
CONFIG_SYS_MAXARGS=32
CONFIG_CMD_BOOTZ=y
CONFIG_CMD_DM=y
CONFIG_CMD_GPIO=y
CONFIG_CMD_MMC=y
CONFIG_CMD_USB=y
# CONFIG_CMD_SETEXPR is not set
CONFIG_CMD_CACHE=y
CONFIG_CMD_EXT2=y
CONFIG_CMD_FAT=y
CONFIG_OF_CONTROL=y
CONFIG_ENV_OVERWRITE=y
CONFIG_ENV_IS_IN_MMC=y
CONFIG_ENV_RELOC_GD_ENV_ADDR=y
CONFIG_USE_BOOTFILE=y
CONFIG_BOOTFILE="uImage"
CONFIG_VERSION_VARIABLE=y
CONFIG_NO_NET=y
CONFIG_MXS_GPIO=y
CONFIG_MMC_MXS=y
CONFIG_PINCTRL=y
CONFIG_DM_REGULATOR=y
CONFIG_DM_REGULATOR_FIXED=y
CONFIG_DM_REGULATOR_GPIO=y
CONFIG_CONS_INDEX=0
CONFIG_DM_SERIAL=y
CONFIG_USB=y
CONFIG_USB_EHCI_HCD=y
CONFIG_USB_STORAGE=y
CONFIG_CMD_FUSE=y
CONFIG_MXS_OCOTP=y
CONFIG_APBH_DMA_BURST8=y
CONFIG_APBH_DMA_BURST=y
CONFIG_CLK=y
CONFIG_CMD_FLASH=y
CONFIG_CMD_MTDPARTS=y
CONFIG_CMD_MTD=y
CONFIG_CMD_NAND_LOCK_UNLOCK=y
CONFIG_CMD_NAND_TRIMFFS=y
CONFIG_CMD_NAND=y
CONFIG_CMD_PART=y
CONFIG_CMD_SQUASHFS=y
CONFIG_CMD_UBIFS=y
CONFIG_CMD_UBI_RENAME=y
CONFIG_CMD_UBI=y
CONFIG_FS_JFFS2=y
CONFIG_FS_SQUASHFS=y
CONFIG_DM_MTD=y
CONFIG_MTD_CONCAT=y
CONFIG_MTDIDS_DEFAULT="nand0=gpmi-nand"
CONFIG_MTD_PARTITIONS=y
CONFIG_MTDPARTS_DEFAULT="mtdparts=gpmi-nand:64m(boot),16m(env1),16m(env2),-(spare)"
CONFIG_MTD_RAW_NAND=y
CONFIG_MTD_UBI_BEB_LIMIT=20
CONFIG_MTD_UBI_MODULE=y
CONFIG_MTD_UBI_WL_THRESHOLD=4096
CONFIG_MTD_UBI=y
CONFIG_MTD=y
CONFIG_NAND_MXS_DT=y
CONFIG_NAND_MXS=y
CONFIG_SYS_MAX_NAND_DEVICE=1
CONFIG_SYS_NAND_DRIVER_ECC_LAYOUT=y
CONFIG_SYS_NAND_MAX_CHIPS=1
CONFIG_SYS_NAND_MAX_ECCPOS=680
CONFIG_SYS_NAND_MAX_OOBFREE=32
CONFIG_SYS_NAND_ONFI_DETECTION=y
CONFIG_SYS_NAND_USE_FLASH_BBT=n
```
